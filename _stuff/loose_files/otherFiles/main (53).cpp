/* =============================================================================
 * Project:		GPS Example Application
 * File name:	main.cpp
 * Authors:		Leandro Schwarz
 * 				Thiago Martins Prim
 * Date:		September 24, 2018
 * Purpose:		Tool to test GPS comunication.
 * ========================================================================== */

// =============================================================================
// Include files
// =============================================================================

#include <gpdseAvrGlobalDefines.hpp>
#include <gpdseAvrUsart.hpp>
#include <gpdseAvrCircularBuffer8.hpp>
#include <gpdseAvrParserAt.hpp>

// =============================================================================
// File exclusive - Constants
// =============================================================================

// NONE

// =============================================================================
// Data Stored in Flash
// =============================================================================

// NONE

// =============================================================================
// File exclusive - New data types
// =============================================================================

// NONE

// =============================================================================
// File exclusive - Macro-functions
// =============================================================================

// NONE

// =============================================================================
// Global variables
// =============================================================================

volatile bool loopBack = false;

CircularBuffer8 buffer(50);

// =============================================================================
// Function declarations
// =============================================================================

// NONE

// -----------------------------------------------------------------------------
// Main Function ---------------------------------------------------------------

int main(void)
{
	// =========================================================================
	// General Purpose Variables
	// =========================================================================

	// NONE

	// =========================================================================
	// Variable Initialization
	// =========================================================================

	// NONE

	// =========================================================================
	// LED Configuration
	// =========================================================================

	ledEnable();
	ledTurnOff();

	// =========================================================================
	// Usart0 Configuration
	// =========================================================================

	if (usart0.getLastError()) {
		systemHalt();
	}
	usart0.setTransmitter(ACTIVATION_ON);
	usart0.setReceiver(ACTIVATION_ON);
	if (!usart0.initialize()) {
		systemHalt();
	}
	usart0.remapStdio();

	// =========================================================================
	// Circular Buffer Configuration
	// =========================================================================
	if (buffer.getLastError()) {
		printf("ERRO - CIRCULAR BUFFER - %d\r", buffer.getLastError());
	}

	// =========================================================================
	// Interrupts
	// =========================================================================

	// Enable global interrupts
	sei();

	// Enable USART interrupt
	usart0.flushDataReceptionBuffer();
	usart0.setInterruptReceptionComplete(true);


	// -------------------------------------------------------------------------
	// Main Loop ---------------------------------------------------------------

	while (1) {
		if (loopBack) {
			uint16_t bufferLength = 0;
			bufferLength = buffer.getOccupation();
			if (bufferLength) {
				char auxBuf[50];
				buffer.popBuffer((uint8_t *)auxBuf, bufferLength);
				printf("\r\r%s\r\r", auxBuf);
			}
			loopBack = false;
		}
	}

	return 0;							// Never Reached Return
}

// =============================================================================
// Interruption Handlers
// =============================================================================

ISR(USART_RX_vect)
{
	uint8_t data;

	usart0.receiveData(&data);
	if (data == 0x0D) {
		loopBack = true;
	} else {
		buffer.push(data);
	}
	usart0.sendData(data);
}

// =============================================================================
// Function Definitions
// =============================================================================

// NONE
